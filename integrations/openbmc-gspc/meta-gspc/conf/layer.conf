## integrations/openbmc-gspc/meta-gspc/conf/layer.conf
```bitbake
BBPATH .= ":${LAYERDIR}"
BBFILES += "${LAYERDIR}/recipes-*/*/*.bb"
BBFILE_COLLECTIONS += "gspc"
BBFILE_PATTERN_gspc = "^${LAYERDIR}/"
BBFILE_PRIORITY_gspc = "5"
LAYERSERIES_COMPAT_gspc = "scarthgap styhead walnascar"
```
